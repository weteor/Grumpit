## firmware/boards/shields/grumpit/Kconfig.defconfig
```kconfig
if SHIELD_GRUMPIT_LEFT

# Name must be less than 16 characters long!
config ZMK_KEYBOARD_NAME
    default "Grump'it"

config ZMK_SPLIT_ROLE_CENTRAL
    default y

config ZMK_USB
    default y

endif

if SHIELD_GRUMPIT_LEFT || SHIELD_GRUMPIT_RIGHT

config ZMK_SPLIT
    default y

config ZMK_BLE
    default y

config ZMK_SLEEP
    default y

config ZMK_PM_SOFT_OFF
    default y

endif
```

## firmware/boards/shields/grumpit/Kconfig.shield
```kconfig
# No whitespace after the comma or in your part name!
config SHIELD_GRUMPIT_LEFT
    def_bool $(shields_list_contains,grumpit_left)

# No whitespace after the comma or in your part name!
config SHIELD_GRUMPIT_RIGHT
    def_bool $(shields_list_contains,grumpit_right)
```
